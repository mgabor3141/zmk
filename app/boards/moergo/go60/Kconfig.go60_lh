## app/boards/moergo/go60/Kconfig.go60_lh
```kconfig
# Copyright (c) 2021 The ZMK Contributors
# SPDX-License-Identifier: MIT

config BOARD_GO60_LH
    select SOC_NRF52840_QIAA
    select SOC_DCDC_NRF52X
    select ZMK_BOARD_COMPAT
    imply RETAINED_MEM
    imply RETENTION
    imply RETENTION_BOOT_MODE
```

## app/dts/bindings/behaviors/zmk,behavior-default-layer.yaml
```yaml
# Copyright (c) 2024 The ZMK Contributors
# SPDX-License-Identifier: MIT

description: Behavior to set the default layer for the current endpoint (persisted to flash)

compatible: "zmk,behavior-default-layer"

include: one_param.yaml
```

## app/dts/bindings/behaviors/zmk,behavior-endpoint-os.yaml
```yaml
# Copyright (c) 2026 The ZMK Contributors
# SPDX-License-Identifier: MIT

description: Set the OS type for the current endpoint (0=Linux, 1=macOS). Persists to flash.

compatible: "zmk,behavior-endpoint-os"

include: one_param.yaml
```

## app/dts/bindings/zmk,underglow-indicators.yaml
```yaml
# Copyright (c) 2020 The ZMK Contributors
# SPDX-License-Identifier: MIT

description: |
  Maps LED pixel indices to status indicator roles for the RGB underglow
  status overlay. Activated via &rgb_ug RGB_STATUS in a keymap.

compatible: "zmk,underglow-indicators"

properties:
  bat-lhs:
    type: array
    required: true
    description: LED pixel indices for left-hand battery bar graph
  bat-rhs:
    type: array
    required: true
    description: LED pixel indices for right-hand battery bar graph
  capslock:
    type: int
    required: true
    description: LED pixel index for CapsLock indicator
  numlock:
    type: int
    required: true
    description: LED pixel index for NumLock indicator
  scrolllock:
    type: int
    required: true
    description: LED pixel index for ScrollLock indicator
  layer-state:
    type: array
    required: true
    description: |
      LED pixel indices for active layer indicators. Indexed by layer number:
      entry N is the pixel to light when layer N is active. Use 0xFF to skip
      a layer (e.g. for purely momentary layers that don't need an indicator).
  ble-state:
    type: array
    required: true
    description: LED pixel indices for BLE profile status
  usb-state:
    type: int
    required: true
    description: LED pixel index for USB connection status
  output-fallback:
    type: int
    required: true
    description: LED pixel index shown when preferred transport is not active
```
